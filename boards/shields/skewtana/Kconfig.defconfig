## boards/shields/skewtana/Kconfig.defconfig
```kconfig
if SHIELD_SKEWTANA_LEFT

# Name must be less than 16 characters long!
config ZMK_KEYBOARD_NAME
    default "Skewtana"
config ZMK_SPLIT_ROLE_CENTRAL
    default y

endif


if SHIELD_SKEWTANA_RIGHT
# Name must be less than 16 characters long!
config ZMK_KEYBOARD_NAME
    default "Skewtana"

endif


if SHIELD_SKEWTANA_LEFT || SHIELD_SKEWTANA_RIGHT

config ZMK_SPLIT
    default y

endif
```

## boards/shields/skewtana/Kconfig.shield
```kconfig
# No whitespace after the comma or in your part name!
config SHIELD_SKEWTANA_LEFT
    def_bool $(shields_list_contains,skewtana_left)

# No whitespace after the comma or in your part name!
config SHIELD_SKEWTANA_RIGHT
    def_bool $(shields_list_contains,skewtana_right)
```
